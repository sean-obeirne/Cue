## v1/sdkconfig.defaults
```kconfig
# Cue — ESP32-S3-N16R8 sdkconfig defaults
# Apply with `idf.py set-target esp32s3 && idf.py reconfigure`.

CONFIG_IDF_TARGET="esp32s3"

# 16 MB flash, octal mode (matches N16R8 module)
CONFIG_ESPTOOLPY_FLASHSIZE_16MB=y
CONFIG_ESPTOOLPY_FLASHMODE_QIO=y
CONFIG_ESPTOOLPY_FLASHFREQ_80M=y

# 8 MB PSRAM, octal mode
CONFIG_SPIRAM=y
CONFIG_SPIRAM_MODE_OCT=y
CONFIG_SPIRAM_SPEED_80M=y
CONFIG_SPIRAM_USE_MALLOC=y

# Larger main task stack — UI + audio paths chew through it
CONFIG_ESP_MAIN_TASK_STACK_SIZE=8192

# Use the custom partition table so we get a roomy app slot + storage.
CONFIG_PARTITION_TABLE_CUSTOM=y
CONFIG_PARTITION_TABLE_CUSTOM_FILENAME="partitions.csv"

# Bluetooth (placeholder for future A2DP audio sink/source).
# Disabled by default to keep the binary small until bt_audio is real.
# CONFIG_BT_ENABLED=y
# CONFIG_BT_BLUEDROID_ENABLED=y
# CONFIG_BT_A2DP_ENABLE=y

# Logging
CONFIG_LOG_DEFAULT_LEVEL_INFO=y

# FreeRTOS tick — keep at 1 kHz so vTaskDelay(1) ≈ 1 ms.
CONFIG_FREERTOS_HZ=1000
```
